## Documentation/devicetree/bindings/arm/mediatek/mediatek,mmsys.txt
```
Mediatek mmsys clock controller
============================

The Mediatek mmsys controller provides various clocks to the system.

Required Properties:

- compatible: Should be one of:
	- "mediatek,mt6779-mmsys", "syscon"
	- "mediatek,mt6797-mmsys", "syscon"
	- "mediatek,mt7623-mmsys", "mediatek,mt2701-mmsys", "syscon"
	- "mediatek,mt8173-mmsys", "syscon"
	- "mediatek,mt8183-mmsys", "syscon"
	- "mediatek,mt2712-mmsys-clk", "syscon", "simple-mfd"
	- "mediatek,mt6797-mmsys-clk", "syscon", "simple-mfd"
- #clock-cells: Must be 1

The mmsys clock controller uses the common clk binding from
Documentation/devicetree/bindings/clock/clock-bindings.txt
The available clocks are defined in dt-bindings/clock/mt*-clk.h.
It is a child of the mmsys block, see binding at:
Documentation/devicetree/bindings/display/mediatek/mediatek,disp.txt

Example:

mmsys: syscon@14000000 {
	compatible = "mediatek,mt2712-mmsys", "syscon", "simple-mfd";
	reg = <0 0x14000000 0 0x1000>;

	mmsys_clk: clock-controller@14000000 {
		compatible = "mediatek,mt2712-mmsys-clk";
		#clock-cells = <1>;
	};

};
```

## Documentation/devicetree/bindings/chrome/google,cros-ec-typec.yaml
```yaml
# SPDX-License-Identifier: GPL-2.0
%YAML 1.2
---
$id: http://devicetree.org/schemas/chrome/google,cros-ec-typec.yaml#
$schema: http://devicetree.org/meta-schemas/core.yaml#

title: Google Chrome OS EC(Embedded Controller) Type C port driver.

maintainers:
  - Benson Leung <bleung@chromium.org>
  - Prashant Malani <pmalani@chromium.org>

description:
  Chrome OS devices have an Embedded Controller(EC) which has access to
  Type C port state. This node is intended to allow the host to read and
  control the Type C ports. The node for this device should be under a
  cros-ec node like google,cros-ec-spi.

properties:
  compatible:
    const: google,cros-ec-typec

  port:
    description: A node that represents a physical Type C port on the
      device.
    type: object
    properties:
      port-number:
        description: The number used by the Chrome OS EC to identify
          this type C port.
        $ref: /schemas/types.yaml#/definitions/uint32
      power-role:
        description: Determines the power role that the Type C port will
          adopt.
        oneOf:
          - items:
            - const: sink
            - const: source
            - const: dual
      data-role:
        description: Determines the data role that the Type C port will
          adopt.
        oneOf:
          - items:
            - const: host
            - const: device
            - const: dual
      try-power-role:
        description: Determines the preferred power role of the Type C port.
        oneOf:
          - items:
            - const: sink
            - const: source
            - const: dual

    required:
      - port-number
      - power-role
      - data-role
      - try-power-role

required:
  - compatible
  - port

examples:
  - |+
    typec {
      compatible = "google,cros-ec-typec";

      port@0 {
        port-number = <0>;
        power-role = "dual";
        data-role = "dual";
        try-power-role = "source";
      };
    };
```

## Documentation/devicetree/bindings/mfd/mediatek,mmsys.txt
```
MediaTek MMSYS Multifunction Device Driver

MMSYS is a multifunction device with the following sub modules:
- clocks for the multi-media subsystem
- central node for the DRM subsystem.

This document describes the binding for MFD device. The MFD takes care to initailize
the clock driver and the DRM driver. More info see
Documentation/devicetree/bindings/display/mediatek/mediatek,disp.txt

Required properties:
- compatible: Should be one of:
	- "mediatek,mt2701-mmsys", "syscon"
	- "mediatek,mt8173-mmsys", "syscon"
- #clock-cells: Must be 1

Optional properties:
- power-domains: list of powerdomains needed for the subsystem to work

Example:

mmsys: clock-controller@14000000 {
	compatible = "mediatek,mt8173-mmsys", "syscon";
	reg = <0 0x14000000 0 0x1000>;
	power-domains = <&scpsys MT8173_POWER_DOMAIN_MM>;
	#clock-cells = <1>;
};
```

## Documentation/devicetree/bindings/power/mediatek,power-controller.yaml
```yaml
# SPDX-License-Identifier: (GPL-2.0-only OR BSD-2-Clause)
%YAML 1.2
---
$id: http://devicetree.org/schemas/power/mediatek,power-controller.yaml#
$schema: http://devicetree.org/meta-schemas/core.yaml#

title: Mediatek Power Domains

maintainers:
  - Weiyi Lu <weiyi.lu@mediatek.com>
  - Matthias Brugger <mbrugger@suse.com>

description: |
  Mediatek processors include support for multiple power domains which can be
  powered up/down by software based on different application scenes to save power.

  Power domains contained within power-controller node are generic power domain
  providers documented in Documentation/devicetree/bindings/power/power-domain.yaml.

properties:
  power-controller:
    type: object
    description: List of power domains provided by this controller.

    properties:
      compatible:
        enum:
          - mediatek,mt8173-power-controller

      reg:
        description: |
          Power domain index. Valid values are defined in:
              "include/dt-bindings/power/mt8173-power.h" - for MT8173 type power domain.
        maxItems: 1

      clocks:
        description: |
          A number of phandles to clocks that need to be enabled during domain
          power-up sequencing.

      clock-names:
        description: |
          List of names of clocks, in order to match the power-up sequencing
          for each power domain we need to group the clocks by name. BASIC
          clocks need to be enabled before enabling the corresponding power
          domain, and should not have a '-' in their name (i.e mm, mfg, venc).
          SUSBYS clocks need to be enabled before releasing the bus protection,
          and should contain a '-' in their name (i.e mm-0, isp-0, cam-0).

      power-supply: true

    required:
      - compatible
      - reg

additionalProperties: false

examples:
  - |
    #include <dt-bindings/clock/mt8173-clk.h>
    #include <dt-bindings/power/mt8173-power.h>

    soc {
        #address-cells = <2>;
        #size-cells = <2>;

        scpsys: power-controller@10006000 {
            compatible = "mediatek,mt8173-power-controller";
            reg = <0 0x10006000 0 0x1000>;
            #power-domain-cells = <1>;

            #address-cells = <1>;
            #size-cells = <0>;

            /* power domains of the SoC */
            vdec@MT8173_POWER_DOMAIN_VDEC {
                    reg = <MT8173_POWER_DOMAIN_VDEC>;
                    clocks = <&topckgen CLK_TOP_MM_SEL>;
                    clock-names = "mm";
                    #power-domain-cells = <0>;
            };

            venc@MT8173_POWER_DOMAIN_VENC {
                    reg = <MT8173_POWER_DOMAIN_VENC>;
                    clocks = <&topckgen CLK_TOP_MM_SEL>,
                             <&topckgen CLK_TOP_VENC_SEL>;
                    clock-names = "mm", "venc";
                    #power-domain-cells = <0>;
            };
            isp@MT8173_POWER_DOMAIN_ISP {
                    reg = <MT8173_POWER_DOMAIN_ISP>;
                    clocks = <&topckgen CLK_TOP_MM_SEL>;
                    clock-names = "mm";
                    #power-domain-cells = <0>;
            };
            mm@MT8173_POWER_DOMAIN_MM {
                    reg = <MT8173_POWER_DOMAIN_MM>;
                    clocks = <&topckgen CLK_TOP_MM_SEL>;
                    clock-names = "mm";
                    #power-domain-cells = <0>;
                    mediatek,infracfg = <&infracfg>;
            };
            venc_lt@MT8173_POWER_DOMAIN_VENC_LT {
                    reg = <MT8173_POWER_DOMAIN_VENC_LT>;
                    clocks = <&topckgen CLK_TOP_MM_SEL>,
                             <&topckgen CLK_TOP_VENC_LT_SEL>;
                    clock-names = "mm", "venclt";
                    #power-domain-cells = <0>;
            };
            audio@MT8173_POWER_DOMAIN_AUDIO {
                    reg = <MT8173_POWER_DOMAIN_AUDIO>;
                    #power-domain-cells = <0>;
            };
            usb@MT8173_POWER_DOMAIN_USB {
                    reg = <MT8173_POWER_DOMAIN_USB>;
                    #power-domain-cells = <0>;
            };
            mfg_async@MT8173_POWER_DOMAIN_MFG_ASYNC {
                    reg = <MT8173_POWER_DOMAIN_MFG_ASYNC>;
                    clocks = <&clk26m>;
                    clock-names = "mfg";
                    #address-cells = <1>;
                    #size-cells = <0>;
                    #power-domain-cells = <1>;

                    mfg_2d@MT8173_POWER_DOMAIN_MFG_2D {
                            reg = <MT8173_POWER_DOMAIN_MFG_2D>;
                            #address-cells = <1>;
                            #size-cells = <0>;
                            #power-domain-cells = <1>;

                            mfg@MT8173_POWER_DOMAIN_MFG {
                                    reg = <MT8173_POWER_DOMAIN_MFG>;
                                    #power-domain-cells = <0>;
                                    mediatek,infracfg = <&infracfg>;
                            };
                    };
            };
        };
    };
```

## Documentation/devicetree/bindings/spi/omap-spi.txt
```
OMAP2+ McSPI device

Required properties:
- compatible :
  - "ti,omap2-spi" for OMAP2 & OMAP3.
  - "ti,omap4-spi" for OMAP4+.
- ti,spi-num-cs : Number of chipselect supported  by the instance.
- ti,hwmods: Name of the hwmod associated to the McSPI
- ti,pindir-d0-out-d1-in: Select the D0 pin as output and D1 as
			  input. The default is D0 as input and
			  D1 as output.

SPI Controller specific data in SPI slave nodes:

- The spi slave nodes can provide the following information which is used
  by the spi controller.

- ti,spi-cs-per-word: Set chipselect to be toggled on every word send.

- ti,spi-turbo-mode: Set turbo mode for this device.


Example:

- SoC Specific Portion:

mcspi1: mcspi@1 {
    #address-cells = <1>;
    #size-cells = <0>;
    compatible = "ti,omap4-mcspi";
    ti,hwmods = "mcspi1";
    ti,spi-num-cs = <4>;
};

- Board Specific Portion:

	spi-device@0 {
		#address-cells = <1>;
		#size-cells = <1>;

		controller-data {
			ti,spi-cs-per-word = <1>;
			ti,spi-turbo-mode = <0>;
		};
	};
```

## Documentation/devicetree/bindings/thermal/mediatek,thermal.yaml
```yaml
# SPDX-License-Identifier: (GPL-2.0-only OR BSD-2-Clause)
%YAML 1.2
---
$id: http://devicetree.org/schemas/thermal/mediatek,thermal.yaml#
$schema: http://devicetree.org/meta-schemas/core.yaml#

title: MediaTek Thermal Sensor

maintainers:
  - Matthias Brugger <matthias.bgg@gmail.com>

description: |
  The MediaTek thermal controller measures the on-SoC temperatures.
  This device does not have its own ADC, instead it directly controls
  the AUXADC via AHB bus accesses. For this reason this device needs
  phandles to the AUXADC. Also it controls a mux in the apmixedsys
  register space via AHB bus accesses, so a phandle to the APMIXEDSYS
  is also needed.

properties:
  compatible:
    oneOf:
      - enum:
          - mediatek,mt2701-thermal
          - mediatek,mt2712-thermal
          - mediatek,mt7622-thermal
          - mediatek,mt7986-thermal
          - mediatek,mt8173-thermal
          - mediatek,mt8183-thermal
          - mediatek,mt8365-thermal
      - items:
          - const: mediatek,mt7981-thermal
          - const: mediatek,mt7986-thermal
      - items:
          - const: mediatek,mt8516-thermal
          - const: mediatek,mt2701-thermal

  reg:
    maxItems: 1

  interrupts:
    maxItems: 1

  clocks:
    maxItems: 2

  clock-names:
    items:
      - const: therm
      - const: auxadc

  resets:
    maxItems: 1

  reset-names:
    items:
      - const: therm

  nvmem-cells:
    items:
      - description: Calibration eFuse data. If unspecified default values are used.

  nvmem-cell-names:
    items:
      - const: calibration-data

  mediatek,auxadc:
    $ref: /schemas/types.yaml#/definitions/phandle
    description:
      A phandle to the AUXADC which the thermal controller uses.

  mediatek,apmixedsys:
    $ref: /schemas/types.yaml#/definitions/phandle
    description:
      A phandle to the APMIXEDSYS controller.

  "#thermal-sensor-cells":
    const: 1

  bank0-supply:
    description: Regulator supplying voltage to the first bank

  bank1-supply:
    description: Regulator supplying voltage to the second bank

required:
  - compatible
  - reg
  - interrupts
  - clocks
  - mediatek,auxadc
  - mediatek,apmixedsys
  - "#thermal-sensor-cells"

additionalProperties: false

examples:
  - |
    #include <dt-bindings/interrupt-controller/arm-gic.h>
    #include <dt-bindings/clock/mt8173-clk.h>
    #include <dt-bindings/reset/mt8173-resets.h>

    soc {
      #address-cells = <2>;
      #size-cells = <2>;

      thermal: thermal@1100b000 {
        #thermal-sensor-cells = <1>;
        compatible = "mediatek,mt8173-thermal";
        reg = <0 0x1100b000 0 0x1000>;
        interrupts = <0 70 IRQ_TYPE_LEVEL_LOW>;
        clocks = <&pericfg CLK_PERI_THERM>, <&pericfg CLK_PERI_AUXADC>;
        clock-names = "therm", "auxadc";
        resets = <&pericfg MT8173_PERI_THERM_SW_RST>;
        reset-names = "therm";
        mediatek,auxadc = <&auxadc>;
        mediatek,apmixedsys = <&apmixedsys>;
        nvmem-cells = <&thermal_calibration_data>;
        nvmem-cell-names = "calibration-data";
      };

      thermal-zones {
        cpu_thermal: cpu-thermal {
          polling-delay-passive = <1000>;
          polling-delay = <1000>;

          thermal-sensors = <&thermal 0>;
          sustainable-power = <1500>;

          trips {
            threshold: trip-point0 {
              temperature = <68000>;
              hysteresis = <2000>;
              type = "passive";
            };

            target: trip-point1 {
              temperature = <85000>;
              hysteresis = <2000>;
              type = "passive";
            };

            cpu_crit: cpu-crit0 {
              temperature = <115000>;
              hysteresis = <2000>;
              type = "critical";
            };
          };
        };
      };
    };
...
```

## Documentation/devicetree/bindings/timer/mediatek,mtk-timer.txt
```
Mediatek MT6598, MT6577 and MT6572 Timers
---------------------------------------

Required properties:
- compatible: Should be either "mediatek,mtk6589-timer", "mediatek,mtk6577-timer" or
  "mediatek,mtk6572-timer" as appropriate.
- reg: Should contain location and length for timers register.
- clock-names : Must include the following entries:
  "sysclk" (13 MHz system clock),
  "rtcclk" (32 KHz RTC clock).

Examples:

	timer {
		compatible = "mediatek,mtk6589-timer";
		reg = <0x10008000 0x30>;
		interrupts = <145>;
		clocks = <&system-13m>, <&rtc-clk-32k>;
		clock-names = "sysclk", "rtcclk";
	};
```

## arch/arm/mach-mediatek/Kconfig
```kconfig
config ARCH_MEDIATEK
	bool "Mediatek SOCs" if ARCH_MULTI_V7
	select ARCH_REQUIRE_GPIOLIB
	select ARM_GIC
	select CACHE_L2X0
	select HAVE_ARM_TWD if LOCAL_TIMERS
	select HAVE_SMP
	select LOCAL_TIMERS if SMP
	select COMMON_CLK
	select GENERIC_CLOCKEVENTS
	select MTK_TIMER
	select CLKSRC_MMIO
	help
	  Support for Mediatek Cortex-A7 Quad-Core-SoC MT6589.
```

## arch/avr32/boards/wismit/Kconfig
```kconfig
# wismit customization

if BOARD_WISMIT

config BOARD_WISMIT_HSB_MATRIX_TUNE
   bool "Tune hsb matrix to prioritze SPI controller"
   help
      Tunes the High Speed Bus Matrix to give Peripheral DMA Controller
      direct connection to EBI interface.

      Choose 'Y' if you make heavy use of SPI on your Board.

endif # BOARD_WISMIT
```
