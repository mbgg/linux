## drivers/gpu/drm/bridge/analogix/Kconfig
```kconfig
# SPDX-License-Identifier: GPL-2.0-only
config DRM_ANALOGIX_ANX6345
	tristate "Analogix ANX6345 bridge"
	depends on OF
	select DRM_ANALOGIX_DP
	select DRM_KMS_HELPER
	select REGMAP_I2C
	help
	  ANX6345 is an ultra-low Full-HD DisplayPort/eDP
	  transmitter designed for portable devices. The
	  ANX6345 transforms the LVTTL RGB output of an
	  application processor to eDP or DisplayPort.

config DRM_ANALOGIX_ANX7688
	tristate "Analogix ANX7688 bridge"
	select DRM_KMS_HELPER
	select REGMAP_I2C
	help
	  ANX7688 is a transmitter to support DisplayPort over USB-C for
	  smartphone and tablets. This driver only supports the HDMI to
	  DP component of the chip.

config DRM_ANALOGIX_ANX78XX
	tristate "Analogix ANX78XX bridge"
	select DRM_ANALOGIX_DP
	select DRM_KMS_HELPER
	select REGMAP_I2C
	help
	  ANX78XX is an ultra-low power Full-HD SlimPort transmitter
	  designed for portable devices. The ANX78XX transforms
	  the HDMI output of an application processor to MyDP
	  or DisplayPort.

config DRM_ANALOGIX_DP
	tristate
	depends on DRM
```
